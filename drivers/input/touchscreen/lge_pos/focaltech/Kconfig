## drivers/input/touchscreen/lge_pos/focaltech/Kconfig
```kconfig
#
# LGE touch core configuration
#
if INPUT_TOUCHSCREEN

source "drivers/input/touchscreen/lge_pos/focaltech/ft5446/Kconfig"
source "drivers/input/touchscreen/lge_pos/focaltech/FT8006P/Kconfig"
source "drivers/input/touchscreen/lge_pos/focaltech/FT8615/Kconfig"
endif
```

## drivers/input/touchscreen/lge_pos/himax/hx83112a/Kconfig
```kconfig
#
# LGE touch core configuration
#
if INPUT_TOUCHSCREEN

menuconfig LGE_TOUCH_HIMAX_HX83112A
	bool "LGE Touch Core ODM Device Driver - HX83112A"
	depends on LGE_TOUCH_CORE_BASE
	help
	  If your device is hx83112A, say Y

menuconfig LGE_TOUCH_HIMAX_HX83112A_DEBUG
	bool "LGE Touch Core ODM Device Driver - HX83112A"
	depends on LGE_TOUCH_CORE_BASE
	help
	  If your device is hx83112A, say Y
endif
```

## drivers/input/touchscreen/lge_pos/ilitek/Kconfig
```kconfig
#
# LGE touch core configuration
#
if INPUT_TOUCHSCREEN

source "drivers/input/touchscreen/lge_pos/ilitek/ILI9881H/Kconfig"
source "drivers/input/touchscreen/lge_pos/ilitek/ILI7807G/Kconfig"
source "drivers/input/touchscreen/lge_pos/ilitek/ILI9881X/Kconfig"
endif
```

## drivers/input/touchscreen/lge_pos/synaptics/Kconfig
```kconfig
#
# LGE touch core configuration
#

if INPUT_TOUCHSCREEN


source "drivers/input/touchscreen/lge_pos/synaptics/td4320/Kconfig"

endif
```

## drivers/misc/mediatek/lcm/jdm/Kconfig
```kconfig
config JDM_LCM
	bool "Enable JDM LCM driver"
	default n
	help
	  define JDM LCM driver config to enable LCM driver.
	  Please make sure LG_LCM in xxxxx_defconfig.mk.

source "drivers/misc/mediatek/lcm/jdm/ft8006p_hdplus_dsi_vdo_auo/Kconfig"
source "drivers/misc/mediatek/lcm/jdm/st7703_hdplus_dsi_vdo_lce/Kconfig"
source "drivers/misc/mediatek/lcm/jdm/ft8615_hdplus_dsi_vdo_auo/Kconfig"
source "drivers/misc/mediatek/lcm/jdm/ili7807g_hd_plus_dsi_incell_lc/Kconfig"
```
