/*
 * LG Electronics MT6765 HDK touch device tree source
 *
 * Copyright (c) 2018 LG Electronics Co., Ltd.
 *              http://www.lge.com
 *
 */
#include "../mt6765-meh35lm_touch_common/mt6765-meh35lm-touch-common.dtsi"
