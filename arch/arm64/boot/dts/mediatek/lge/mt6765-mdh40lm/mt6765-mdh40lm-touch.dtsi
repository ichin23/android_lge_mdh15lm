/*
 * LG Electronics MT6765 HDK touch device tree source
 *
 * Copyright (c) 2018 LG Electronics Co., Ltd.
 *              http://www.lge.com
 *
 */

#include "../mt6765-mdh40lm_touch_common/mt6765-mdh40lm-touch.dtsi"
